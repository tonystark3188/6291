## project/NW5002/target/linux/xburst/files/drivers/net/wireless/mrvl8801/Kconfig
```kconfig
config MRVL8801
    tristate "Marvell MRVL8801 SDIO WiFi & BT "
    depends on MMC
    ---help---
    Help message of Marvell MRVL8801 wifi & BT
```
